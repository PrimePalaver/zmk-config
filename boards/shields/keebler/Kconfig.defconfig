## boards/shields/keebler/Kconfig.defconfig
```kconfig
# Copyright (c) 2020 The ZMK Contributors
# SPDX-License-Identifier: MIT

if SHIELD_KEEBLER_LEFT

config ZMK_KEYBOARD_NAME
	default "Keebler"

config ZMK_SPLIT_BLE_ROLE_CENTRAL
	default y

endif


if SHIELD_KEEBLER_LEFT || SHIELD_KEEBLER_RIGHT

config ZMK_SPLIT
	default y

endif
```

## boards/shields/keebler_3d/Kconfig.defconfig
```kconfig
# Add configuration used by only the dongle.
if SHIELD_KEEBLER_3D_DONGLE
config ZMK_KEYBOARD_NAME
	default "Keebler3D Dongle"
config ZMK_SPLIT_BLE_ROLE_CENTRAL
	default y
config ZMK_USB
	default y
endif

# Add common configuration. For dongle, left half, and right half.
if SHIELD_KEEBLER_3D_DONGLE || SHIELD_KEEBLER_3D_LEFT || SHIELD_KEEBLER_3D_RIGHT
config ZMK_SPLIT
	default y
endif
```

## config/boards/shields/keebler/Kconfig.shield
```kconfig
config SHIELD_KEEBLER_LEFT
	def_bool $(shields_list_contains,keebler_left)

config SHIELD_KEEBLER_RIGHT
	def_bool $(shields_list_contains,keebler_right)
```

## config/boards/shields/keebler_3d/Kconfig.defconfig
```kconfig
# Copyright (c) 2020 The ZMK Contributors
# SPDX-License-Identifier: MIT

# TODO(shane): change this back to LEFT
if SHIELD_KEEBLER_3D_RIGHT

config ZMK_KEYBOARD_NAME
	default "Keebler3D"

config ZMK_SPLIT_BLE_ROLE_CENTRAL
	default y

endif


if SHIELD_KEEBLER_3D_LEFT || SHIELD_KEEBLER_3D_RIGHT

config ZMK_SPLIT
	default y

endif
```

## config/boards/shields/keebler_3d/Kconfig.shield
```kconfig
config SHIELD_KEEBLER_3D_LEFT
	def_bool $(shields_list_contains,keebler_3d_left)

config SHIELD_KEEBLER_3D_RIGHT
	def_bool $(shields_list_contains,keebler_3d_right)
```
